## boards/arm/5x12/Kconfig.defconfig
```kconfig
# Copyright (c) 2023 HeeChan Kang
# SPDX-License-Identifier: MIT

if BOARD_5x12

config BOARD
    default "5x12"

config ZMK_KEYBOARD_NAME
    default "kei 5x12"

if USB

config USB_NRFX
    default y

config USB_DEVICE_STACK
    default y

endif # USB

config BT_CTLR
    default BT

config ZMK_BLE
    default y

config ZMK_USB
    default y

endif # BOARD_5x12
```
